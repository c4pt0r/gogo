## platform/esp32s3/main/Kconfig.projbuild
```kconfig
menu "gogo"

    config GOGO_KBD
        bool "Keyboard port (kbd)"
        default y
        help
            Build the TCA8418 keyboard driver and the I2C bus it needs
            (Cardputer ADV; no effect on the StickS3, which has no keyboard).
            When off, port.Open("kbd") fails with errors.NotFound and the IDF I2C
            master driver is not linked into the Cardputer firmware.

    config GOGO_BATTERY
        bool "Battery port (power)"
        default y
        help
            Build the battery reader: the ADC divider on the Cardputer, the
            M5PM1 on the StickS3. When off, port.Open("power") fails
            with errors.NotFound. The StickS3 still uses I2C for the PM1 LCD rail when
            the console is on.

    config GOGO_NET
        bool "Network (Wi-Fi + net stack)"
        default y
        help
            Build the Wi-Fi station driver and gogo's net stack (netif, udp,
            tcp, tcp_listen ports). When off, the capability "net" is absent
            (an image that needs it is refused at boot), port.Open of those
            ports fails with errors.NotFound, net.Subscribe returns false, and
            `gogo device scan` answers "no network in this firmware" and `stats`
            prints only the memory figures.
            esp_wifi, wpa_supplicant, libnet80211, libpp and libphy are not linked.

    config GOGO_SD
        bool "microSD card (/sd on FatFs)"
        default y
        help
            Build fs_fat.c (the /sd backend on FatFs) and the SD driver
            (Cardputer ADV; no effect on the StickS3, which has no slot).
            When off, /sd is not registered (every path is NotMounted),
            CAP_SD is absent, and FatFs, sdmmc and sdspi are not linked.
            The SD pins (G12, G14, G39, G40) stay reserved: the card slot
            is still wired to them, so the gpio port keeps refusing them.

    config GOGO_FS_EXFAT
        bool "exFAT on the SD card"
        depends on GOGO_SD
        default y
        help
            Compile FatFs with exFAT (FF_FS_EXFAT 1, components/fatfs/src
            /ffconf.h). When off, only FAT12/16/32 mount; an exFAT card
            fails with the existing "no FAT or exFAT file system" message
            and /sd stays NotMounted.

    config GOGO_IMU
        bool "Motion sensor port (imu)"
        default y
        help
            Build the BMI270 IMU driver (imu_esp.c, both boards, on the
            shared I2C bus) and its 8 KB legacy configuration (Bosch,
            BSD-3). When off, CAP_IMU is absent (an image that needs it is
            refused at boot), port.Open("imu") fails with errors.NotFound, and on the
            Cardputer with GOGO_KBD also off the IDF I2C driver is not
            linked.

    config GOGO_IR
        bool "Infrared ports (ir_tx, ir_rx)"
        default y
        help
            Build the RMT infrared drivers (ir_esp.c): ir_tx on both
            boards (StickS3 G46, Cardputer G44), ir_rx on the StickS3 only
            (G42). When off, CAP_IR_TX and CAP_IR_RX are absent, port.Open
            of those ports fails with errors.NotFound, and the IDF RMT driver is not
            linked.

    config GOGO_AUDIO
        bool "Audio ports (mic, speaker)"
        default y
        select I2S_ISR_IRAM_SAFE
        help
            Build the audio drivers (audio_esp.c): mic and speaker on both
            boards (ES8311 codec and I2S), and make the I2S interrupt
            IRAM-safe so a /flash write does not lose or replay DMA
            buffers. When off, the mic and speaker drivers are absent,
            port.Open of those ports fails with errors.NotFound, and the IDF I2S
            driver is not linked.

    config GOGO_TLS
        bool "TLS client (https)"
        depends on GOGO_NET
        default y
        help
            Build the "tls" port (runtime/net/tls/tls.c): a TLS 1.2 client over gogo's
            tcp, on ESP-IDF's mbedTLS component (sdkconfig.defaults) with
            the certificate bundle. When off, tls.c is not built, CAP_TLS is
            absent and port.Open("tls") fails with errors.NotFound.

    config GOGO_DIST
        bool "Distributed actors (node)"
        depends on GOGO_NET
        default y
        help
            Build the "node" port (runtime/dist/): links of a distributed node
            (gogo/node), over gogo's tcp. When off, dist.c is not built and
            port.Open("node") returns ok=false (an image that needs it is refused).

    config GOGO_SCREEN
        bool "Text screen port (screen)"
        default y
        help
            Build the "screen" port (runtime/screen/): a 40 x 11 grid of
            character cells with colours and attributes, drawn on the LCD
            by the console's render task (gogo/screen, gogo/tui). When off,
            the board does not list the driver (an image that
            requires "screen" is refused), port.Open("screen") fails with errors.NotFound and
            the LCD only shows the text console.

    config GOGO_FLOAT
        bool "Floating point (float32, float64)"
        default y
        help
            Build float32 and float64 into the VM (runtime/vm/floats.c:
            the float ops) and the float library (runtime/floatlib/:
            printing floats, gogo/math, strconv.FormatFloat and
            ParseFloat, without libm or the C library's conversions). float32 runs on the ESP32-S3's FPU, float64 in
            software. When off, the VM lacks the requirement "float" and
            refuses an image that uses floats ("image requires float,
            which this VM lacks"); code.Load reports it as Missing.

    config GOGO_FONT_CJK
        bool "Chinese console font (GB 2312)"
        default y
        help
            Embed gogo12.font (printable ASCII plus GB 2312, 162958 bytes).
            When off, embed gogo12-ascii.font (printable ASCII only, 1536
            bytes) and every other character shows as the console's box.

    config GOGO_BOARD_PORTS
        bool "Board ports (drivers of other components, gogo.h)"
        default n
        help
            Build the host-port layer into the firmware, so drivers of other
            ESP-IDF components (EXTRA_COMPONENT_DIRS) that register themselves
            with GOGO_BOARD_PORT (runtime/include/gogo.h) are registered at
            boot, before the image loads, and listed in `gogo device info`.
            `gogo firmware -component DIR` turns it on. Off, a component with
            a GOGO_BOARD_PORT fails to link (gogo_board_ports_enabled), when its
            component is linked whole (WHOLE_ARCHIVE, as it must be).

    config GOGO_BOARD_PORT_NAMES
        string "Board ports the components provide (comma-separated)"
        depends on GOGO_BOARD_PORTS
        default ""
        help
            The port names of the components' gogo-driver.json files, which
            `gogo firmware -component` writes here. At boot each one that is
            not registered (a component not linked whole, a GOGO_BOARD_PORT
            spelled otherwise than its gogo-driver.json) is named on the
            serial log.

endmenu
```
